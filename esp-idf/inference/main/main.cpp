/* Edge Impulse Espressif ESP32 Standalone Inference ESP IDF Example
 * Copyright (c) 2022 EdgeImpulse Inc.
 *
 * Permission is hereby granted, free of charge, to any person obtaining a copy
 * of this software and associated documentation files (the "Software"), to deal
 * in the Software without restriction, including without limitation the rights
 * to use, copy, modify, merge, publish, distribute, sublicense, and/or sell
 * copies of the Software, and to permit persons to whom the Software is
 * furnished to do so, subject to the following conditions:
 *
 * The above copyright notice and this permission notice shall be included in
 * all copies or substantial portions of the Software.
 *
 * THE SOFTWARE IS PROVIDED "AS IS", WITHOUT WARRANTY OF ANY KIND, EXPRESS OR
 * IMPLIED, INCLUDING BUT NOT LIMITED TO THE WARRANTIES OF MERCHANTABILITY,
 * FITNESS FOR A PARTICULAR PURPOSE AND NONINFRINGEMENT. IN NO EVENT SHALL THE
 * AUTHORS OR COPYRIGHT HOLDERS BE LIABLE FOR ANY CLAIM, DAMAGES OR OTHER
 * LIABILITY, WHETHER IN AN ACTION OF CONTRACT, TORT OR OTHERWISE, ARISING FROM,
 * OUT OF OR IN CONNECTION WITH THE SOFTWARE OR THE USE OR OTHER DEALINGS IN THE
 * SOFTWARE.
 */

/* Include ----------------------------------------------------------------- */
#include <stdio.h>
#include <esp_heap_caps.h>
#include <esp_system.h>
#include <esp_heap_trace.h>
#include <esp_log.h>
#include <freertos/FreeRTOS.h>
#include <freertos/task.h>

#include "edge-impulse-sdk/classifier/ei_run_classifier.h"

#include "driver/gpio.h"
#include "sdkconfig.h"
#include "esp_idf_version.h"

#include "esp_timer.h"

static const char *TAG = "EI_MAIN";

#define LED_PIN GPIO_NUM_21

// // Memory monitoring and heap integrity checking
// void check_heap_integrity(const char* location) {
//     ESP_LOGI(TAG, "=== Heap Check at %s ===", location);
    
//     // Check heap integrity
//     if (!heap_caps_check_integrity_all(true)) {
//         ESP_LOGE(TAG, "HEAP CORRUPTION detected at %s!", location);
//         ESP_LOGE(TAG, "System will restart in 5 seconds...");
//         vTaskDelay(pdMS_TO_TICKS(5000));
//         esp_restart();
//     }
    
//     // Print memory stats
//     size_t free_heap = esp_get_free_heap_size();
//     size_t min_free_heap = esp_get_minimum_free_heap_size();
//     size_t free_psram = heap_caps_get_free_size(MALLOC_CAP_SPIRAM);
//     size_t largest_block = heap_caps_get_largest_free_block(MALLOC_CAP_8BIT);
    
//     ESP_LOGI(TAG, "Free heap: %zu bytes", free_heap);
//     ESP_LOGI(TAG, "Min free heap ever: %zu bytes", min_free_heap);
//     ESP_LOGI(TAG, "Free PSRAM: %zu bytes", free_psram);
//     ESP_LOGI(TAG, "Largest free block: %zu bytes", largest_block);
    
//     // Check for fragmentation
//     if (largest_block < (free_heap / 2)) {
//         ESP_LOGW(TAG, "Heap fragmentation detected - largest block (%zu) < half of free heap (%zu)", 
//                 largest_block, free_heap);
//     }
// }

// // Custom memory allocation functions for ESP32 with PSRAM support and debugging
// void* ei_malloc(size_t size) {
//     ESP_LOGI(TAG, "ei_malloc: Requesting %zu bytes", size);
    
//     // Check heap integrity before allocation
//     if (!heap_caps_check_integrity_all(false)) {
//         ESP_LOGE(TAG, "Heap corruption detected before malloc!");
//         return NULL;
//     }
    
//     // Try to allocate from PSRAM first, fallback to internal RAM
//     void* ptr = heap_caps_malloc(size, MALLOC_CAP_SPIRAM | MALLOC_CAP_8BIT);
//     if (ptr == NULL) {
//         ESP_LOGW(TAG, "PSRAM allocation failed, trying internal RAM");
//         ptr = heap_caps_malloc(size, MALLOC_CAP_INTERNAL | MALLOC_CAP_8BIT);
//     }
    
//     if (ptr) {
//         ESP_LOGI(TAG, "ei_malloc: Allocated %zu bytes at %p", size, ptr);
//     } else {
//         ESP_LOGE(TAG, "ei_malloc: FAILED to allocate %zu bytes", size);
//     }
    
//     return ptr;
// }

// void* ei_calloc(size_t nmemb, size_t size) {
//     size_t total_size = nmemb * size;
//     ESP_LOGI(TAG, "ei_calloc: Requesting %zu * %zu = %zu bytes", nmemb, size, total_size);
    
//     // Check heap integrity before allocation
//     if (!heap_caps_check_integrity_all(false)) {
//         ESP_LOGE(TAG, "Heap corruption detected before calloc!");
//         return NULL;
//     }
    
//     void* ptr = heap_caps_calloc(nmemb, size, MALLOC_CAP_SPIRAM | MALLOC_CAP_8BIT);
//     if (ptr == NULL) {
//         ESP_LOGW(TAG, "PSRAM calloc failed, trying internal RAM");
//         ptr = heap_caps_calloc(nmemb, size, MALLOC_CAP_INTERNAL | MALLOC_CAP_8BIT);
//     }
    
//     if (ptr) {
//         ESP_LOGI(TAG, "ei_calloc: Allocated %zu bytes at %p", total_size, ptr);
//     } else {
//         ESP_LOGE(TAG, "ei_calloc: FAILED to allocate %zu bytes", total_size);
//     }
    
//     return ptr;
// }

// void ei_free(void* ptr) {
//     if (ptr) {
//         ESP_LOGI(TAG, "ei_free: Freeing memory at %p", ptr);
//         heap_caps_free(ptr);
        
//         // Check heap integrity after free
//         if (!heap_caps_check_integrity_all(false)) {
//             ESP_LOGE(TAG, "Heap corruption detected after freeing %p!", ptr);
//         }
//     } else {
//         ESP_LOGW(TAG, "ei_free: Attempted to free NULL pointer");
//     }
// }

static const float features[] = {
    // copy raw features here (for example from the 'Live classification' page)
    0xf2eae0, 0xf1ebdf, 0xf1ebdf, 0xf0ebe1, 0xf0ebe1, 0xf1eae0, 0xf1eae0, 0xf1eae0, 0xf2ebe1, 0xf1eae0, 0xf0eae0, 0xefebe0,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 0xe9e5d9
};

// void setup_led() {
// #if ESP_IDF_VERSION >= ESP_IDF_VERSION_VAL(5, 0, 0)
//     esp_rom_gpio_pad_select_gpio(LED_PIN);
// #elif ESP_IDF_VERSION >= ESP_IDF_VERSION_VAL(4, 0, 0)
//     gpio_pad_select_gpio(LED_PIN);
// #endif
//     gpio_set_direction(LED_PIN, GPIO_MODE_OUTPUT);
// }

int raw_feature_get_data(size_t offset, size_t length, float *out_ptr) {
  memcpy(out_ptr, features + offset, length * sizeof(float));
  return 0;
}

void print_inference_result(ei_impulse_result_t result) {

    // Print how long it took to perform inference
    ei_printf("Timing: DSP %d ms, inference %d ms, anomaly %d ms\r\n",
            result.timing.dsp,
            result.timing.classification,
            result.timing.anomaly);

    // Print the prediction results (object detection)
#if EI_CLASSIFIER_OBJECT_DETECTION == 1
    ei_printf("Object detection bounding boxes:\r\n");
    for (uint32_t i = 0; i < result.bounding_boxes_count; i++) {
        ei_impulse_result_bounding_box_t bb = result.bounding_boxes[i];
        if (bb.value == 0) {
            continue;
        }
        ei_printf("  %s (%f) [ x: %u, y: %u, width: %u, height: %u ]\r\n",
                bb.label,
                bb.value,
                bb.x,
                bb.y,
                bb.width,
                bb.height);
    }

    // Print the prediction results (classification)
#else
    ei_printf("Predictions:\r\n");
    for (uint16_t i = 0; i < EI_CLASSIFIER_LABEL_COUNT; i++) {
        ei_printf("  %s: ", ei_classifier_inferencing_categories[i]);
        ei_printf("%.5f\r\n", result.classification[i].value);
    }
#endif

    // Print anomaly result (if it exists)
#if EI_CLASSIFIER_HAS_ANOMALY == 1
    ei_printf("Anomaly prediction: %.3f\r\n", result.anomaly);
#endif

}

extern "C" int app_main()
{
    // Initial heap check
    // check_heap_integrity("app_main start");
    
    // setup_led();
    ei_sleep(100);

    ei_impulse_result_t result = { nullptr };
    // Initialize the result structure

    ei_printf("Edge Impulse standalone inferencing (Espressif ESP32)\n");
    
    // Print memory information
    // check_heap_integrity("before main loop");

    if (sizeof(features) / sizeof(float) != EI_CLASSIFIER_DSP_INPUT_FRAME_SIZE)
    {
        ei_printf("The size of your 'features' array is not correct. Expected %d items, but had %u\n",
                EI_CLASSIFIER_DSP_INPUT_FRAME_SIZE, sizeof(features) / sizeof(float));
        return 1;
    }

    int iteration = 0;

    int64_t start_time = esp_timer_get_time();

    while (true)
    {
        iteration++;
        ESP_LOGI(TAG, "=== Starting inference iteration %d ===", iteration);
        
        // Check heap before each iteration
        // check_heap_integrity("iteration start");
        
        // blink LED
        gpio_set_level(LED_PIN, 1);

        // the features are stored into flash, and we don't want to load everything into RAM
        signal_t features_signal;
        features_signal.total_length = sizeof(features) / sizeof(features[0]);
        features_signal.get_data = &raw_feature_get_data;

        ESP_LOGI(TAG, "Running classifier...");
        
        // invoke the impulse
        EI_IMPULSE_ERROR res = run_classifier(&features_signal, &result, false /* debug */);

        ESP_LOGI(TAG, "Classifier finished with result: %d", res);  
        
        
        // Check heap after inference
        // check_heap_integrity("after inference");
        
        // if (res != EI_IMPULSE_OK) {
        //     ei_printf("ERR: Failed to run classifier (%d)\n", res);
        //     check_heap_integrity("after classifier error");
        //     return res;
        // }

        // print_inference_result(result);

        // gpio_set_level(LED_PIN, 0);
        
        // // Check heap before sleep
        // check_heap_integrity("before sleep");
        
        ESP_LOGI(TAG, "=== Completed inference iteration %d ===", iteration);

        // Print the time taken for the inference
        int64_t end_time = esp_timer_get_time();
        int64_t elapsed_time = end_time - start_time;
        elapsed_time /= 1000; // Convert microseconds to milliseconds
        ESP_LOGI(TAG, "Time taken for inference: %lld ms", elapsed_time);
        ESP_LOGI(TAG, "Start time = %lld, End time = %lld", start_time, end_time);
        start_time = end_time; // Reset start time for the next iteration


        ei_sleep(1000); // Increased sleep to allow heap monitoring
    }
}

